## examples/algorithm/mfcc/sdkconfig.defaults
```kconfig
CONFIG_IDF_TARGET="esp32s3"
CONFIG_IDF_TARGET_ESP32S3=y


CONFIG_FREERTOS_HZ=1000
CONFIG_ESPTOOLPY_FLASHFREQ_80M=y
CONFIG_ESPTOOLPY_FLASHMODE_QIO=y

CONFIG_ESP32S3_SPIRAM_SUPPORT=y
CONFIG_SPIRAM_MODE_OCT=y
CONFIG_SPIRAM_SPEED_80M=y
```

## examples/audio/max98357a/sdkconfig.defaults
```kconfig
CONFIG_IDF_TARGET="esp32s3"
CONFIG_IDF_TARGET_ESP32S3=y

CONFIG_PARTITION_TABLE_CUSTOM=y
CONFIG_ESPTOOLPY_FLASHSIZE_8MB=y
CONFIG_ESPTOOLPY_FLASHSIZE="8MB"

CONFIG_ESP32S3_DEFAULT_CPU_FREQ_240=y
```

## examples/audio/music_spectrum/main/Kconfig.projbuild
```kconfig
menu "Music Spectrum Configuration"

    menu "LED Matrix"
        config MUSIC_SPECTRUM_MATRIX_WIDTH
            int "Matrix width"
            range 1 64
            default 16

        config MUSIC_SPECTRUM_MATRIX_HEIGHT
            int "Matrix height"
            range 1 64
            default 16

        config MUSIC_SPECTRUM_LED_GPIO
            int "LED data GPIO"
            range 0 48
            default 18

        config MUSIC_SPECTRUM_RMT_RES_HZ
            int "LED RMT resolution (Hz)"
            range 1000000 40000000
            default 10000000

        config MUSIC_SPECTRUM_RMT_MEM_WORDS
            int "LED RMT memory block symbols"
            range 64 2048
            default 1024

        config MUSIC_SPECTRUM_LED_BRIGHTNESS_PERCENT
            int "LED brightness percent"
            range 1 100
            default 18
    endmenu

    menu "Microphone"
        config MUSIC_SPECTRUM_MIC_I2S_PORT
            int "Microphone I2S port"
            range 0 1
            default 1

        config MUSIC_SPECTRUM_MIC_BCLK_GPIO
            int "Microphone BCLK GPIO"
            range 0 48
            default 16

        config MUSIC_SPECTRUM_MIC_WS_GPIO
            int "Microphone WS GPIO"
            range 0 48
            default 15

        config MUSIC_SPECTRUM_MIC_DIN_GPIO
            int "Microphone DIN GPIO"
            range 0 48
            default 17

        config MUSIC_SPECTRUM_MIC_SAMPLE_RATE
            int "Microphone sample rate"
            range 8000 48000
            default 16000
    endmenu

    menu "Spectrum"
        config MUSIC_SPECTRUM_FRAME_SAMPLES
            int "FFT frame samples"
            range 64 1024
            default 256

        config MUSIC_SPECTRUM_MIN_HZ
            int "Lowest displayed frequency (Hz)"
            range 1 10000
            default 160

        config MUSIC_SPECTRUM_MAX_HZ
            int "Highest displayed frequency (Hz)"
            range 100 12000
            default 7000

        config MUSIC_SPECTRUM_NOISE_FLOOR_MIN
            int "Minimum noise floor"
            range 0 20000
            default 1200

        config MUSIC_SPECTRUM_LEVEL_RANGE
            int "Display level range"
            range 100 20000
            default 5000

        config MUSIC_SPECTRUM_CALIBRATION_MS
            int "Startup noise calibration time (ms)"
            range 0 20000
            default 5000
    endmenu

    menu "Animation"
        config MUSIC_SPECTRUM_SMOOTH_RISE_PERCENT
            int "Rise smoothing percent"
            range 1 100
            default 65

        config MUSIC_SPECTRUM_SMOOTH_FALL_PERCENT
            int "Fall smoothing percent"
            range 1 100
            default 8

        config MUSIC_SPECTRUM_MIN_DELTA
            int "Minimum level delta"
            range 0 5000
            default 60

        config MUSIC_SPECTRUM_DC_BLOCK_ALPHA_PERMILLE
            int "DC blocker alpha (permille)"
            range 0 1000
            default 995
    endmenu

endmenu
```

## examples/audio/ns4150_player/main/Kconfig.projbuild
```kconfig
# NS4150 Player pin and audio configuration

menu "NS4150 Player Configuration"

    config NS4150_PDM_P_GPIO
        int "PDM P (data) GPIO"
        default 7
        range 0 48
        help
            GPIO connected to NS4150 PDM data input (P side).

    config NS4150_USE_PDM_N
        bool "Enable PDM N output (differential)"
        default y
        help
            Enable inverted PDM N output for differential drive.
            Disable if your board uses single-ended output only (PDM N not connected).

    config NS4150_PDM_N_GPIO
        int "PDM N GPIO"
        default 8
        depends on NS4150_USE_PDM_N
        range 0 48
        help
            GPIO for NS4150 PDM N (inverted output). Ignored when "Enable PDM N" is off.

    config NS4150_USE_PA_CTL
        bool "Enable PA control GPIO"
        default y
        help
            Enable GPIO to control amplifier power/shutdown.
            Disable if PA is always on or not controlled by MCU.

    config NS4150_PA_CTL_GPIO
        int "PA control GPIO"
        default 1
        depends on NS4150_USE_PA_CTL
        range 0 48
        help
            GPIO for amplifier enable (high = on).

endmenu
```

## examples/dl/cifar10/esp_cifar10/sdkconfig.defaults
```kconfig
CONFIG_IDF_TARGET="esp32s3"
CONFIG_IDF_TARGET_ESP32S3=y

CONFIG_ESPTOOLPY_FLASHSIZE_16MB=y

CONFIG_ESP32S3_SPIRAM_SUPPORT=y
CONFIG_SPIRAM_MODE_OCT=y
CONFIG_SPIRAM_SPEED_80M=y

CONFIG_PARTITION_TABLE_CUSTOM=y
CONFIG_PARTITION_TABLE_CUSTOM_FILENAME="partitions.csv"
CONFIG_PARTITION_TABLE_FILENAME="partitions.csv"
```

## examples/dl/mnist/esp_mnist/sdkconfig.defaults
```kconfig
CONFIG_IDF_TARGET="esp32s3"
CONFIG_IDF_TARGET_ESP32S3=y

CONFIG_ESPTOOLPY_FLASHSIZE_16MB=y

CONFIG_ESP32S3_SPIRAM_SUPPORT=y
CONFIG_SPIRAM_MODE_OCT=y
CONFIG_SPIRAM_SPEED_80M=y
```

## examples/dl/sin_wave_predict/esp_sin_wave_predict/sdkconfig.defaults
```kconfig
CONFIG_IDF_TARGET="esp32s3"
CONFIG_IDF_TARGET_ESP32S3=y

CONFIG_ESPTOOLPY_FLASHSIZE_16MB=y
```

## examples/dl/wakeup/esp_wakeup/sdkconfig.defaults
```kconfig
CONFIG_IDF_TARGET="esp32s3"
CONFIG_IDF_TARGET_ESP32S3=y
CONFIG_ESP32S3_DEFAULT_CPU_FREQ_240=y

CONFIG_ESPTOOLPY_FLASHSIZE_16MB=y

CONFIG_ESP32S3_SPIRAM_SUPPORT=y
CONFIG_SPIRAM_MODE_OCT=y
CONFIG_SPIRAM_SPEED_80M=y

CONFIG_ESP_INT_WDT=n
CONFIG_ESP_TASK_WDT=n
```

## examples/http/esp_gpt/main/Kconfig.projbuild
```kconfig
menu "Example Configuration"

    config EXAMPLE_ACCESS_TOKEN
        string "Baidu Access Token"
        default "baidu_access_token"
        help
                Access token for baidu.

    config EXAMPLE_TONGYI_KEY
        string "Tongyi Key"
        default "tongyi_key"
        help
                API Key for tongyi.

    config EXAMPLE_WIFI_SSID
        string "wifi ssid"
        default "my_wifi_ssid"
        help
                Wifi SSID.

    config EXAMPLE_WIFI_PSWD
        string "wifi pswd"
        default "my_wifi_pswd"
        help
                Wifi PASSWORD.

endmenu
```

## examples/http/http_baidu_access_token/main/Kconfig.projbuild
```kconfig
menu "Example Configuration"

    config EXAMPLE_CLIENT_ID
        string "Baidu Client Id"
        default "baidu_client_id"
        help
                Client id for baidu.

    config EXAMPLE_CLIENT_SECRET
        string "Baidu Client Secret"
        default "baidu_access_token"
        help
                Client Secret for baidu.

    config EXAMPLE_WIFI_SSID
        string "wifi ssid"
        default "my_wifi_ssid"
        help
                Wifi SSID.

    config EXAMPLE_WIFI_PSWD
        string "wifi pswd"
        default "my_wifi_pswd"
        help
                Wifi PASSWORD.

endmenu
```

## examples/http/http_baidu_img_classification/sdkconfig.defaults
```kconfig
CONFIG_IDF_TARGET="esp32s3"
CONFIG_IDF_TARGET_ESP32S3=y

CONFIG_PARTITION_TABLE_CUSTOM=y
CONFIG_PARTITION_TABLE_CUSTOM_FILENAME="partitions.csv"
CONFIG_PARTITION_TABLE_FILENAME="partitions.csv"

CONFIG_ESP_TLS_INSECURE=y
CONFIG_ESP_TLS_SKIP_SERVER_CERT_VERIFY=y
```

## examples/http/http_baidu_tts/sdkconfig.defaults
```kconfig
CONFIG_ESP_TLS_INSECURE=y
CONFIG_ESP_TLS_SKIP_SERVER_CERT_VERIFY=y

CONFIG_IDF_TARGET="esp32c3"
CONFIG_IDF_TARGET_ESP32C3=y

CONFIG_ESPTOOLPY_FLASHSIZE="4MB"
CONFIG_ESPTOOLPY_FLASHSIZE_4MB=y
```

## examples/http/http_kimi/main/Kconfig.projbuild
```kconfig
menu "Example Configuration"

    config EXAMPLE_KIMI_KEY
        string "Kimi Api Key"
        default "kimi_api_key"
        help
                API key for kimi model.

    config EXAMPLE_WIFI_SSID
        string "wifi ssid"
        default "my_wifi_ssid"
        help
                Wifi SSID.

    config EXAMPLE_WIFI_PSWD
        string "wifi pswd"
        default "my_wifi_pswd"
        help
                Wifi PASSWORD.

endmenu
```

## examples/http/http_kimi/sdkconfig.defaults
```kconfig
CONFIG_ESP_TLS_INSECURE=y
CONFIG_ESP_TLS_SKIP_SERVER_CERT_VERIFY=y

CONFIG_IDF_TARGET="esp32s3"
CONFIG_IDF_TARGET_ESP32s3=y
```

## examples/http/http_xunfei_xinghuo/main/Kconfig.projbuild
```kconfig
menu "Example Configuration"

    config EXAMPLE_XF_KEY
        string "XF Api Key"
        default "xf_api_key"
        help
                API key for xf model.

    config EXAMPLE_XF_SECRET
        string "XF Api Secret"
        default "xf_api_secret"
        help
                API secret for xf model.

    config EXAMPLE_WIFI_SSID
        string "wifi ssid"
        default "my_wifi_ssid"
        help
                Wifi SSID.

    config EXAMPLE_WIFI_PSWD
        string "wifi pswd"
        default "my_wifi_pswd"
        help
                Wifi PASSWORD.

endmenu
```

## examples/lvgl/lcd_camera_lvgl/sdkconfig.defaults
```kconfig
CONFIG_IDF_TARGET="esp32s3"
CONFIG_IDF_TARGET_ESP32S3=y

CONFIG_ESP32S3_DEFAULT_CPU_FREQ_240=y
CONFIG_SPIRAM_SUPPORT=y
CONFIG_ESP32S3_SPIRAM_SUPPORT=y
CONFIG_SPIRAM_SPEED_80M=y
CONFIG_SPIRAM_MODE_OCT=y
CONFIG_ESPTOOLPY_FLASHSIZE_16MB=y

CONFIG_LV_COLOR_16_SWAP=y
```

## examples/peripherals/lcd/lcd_jpg/sdkconfig.defaults
```kconfig
CONFIG_IDF_TARGET="esp32s3"
CONFIG_IDF_TARGET_ESP32S3=y

CONFIG_ESP32S3_DEFAULT_CPU_FREQ_240=y


CONFIG_PARTITION_TABLE_CUSTOM=y
CONFIG_PARTITION_TABLE_CUSTOM_FILENAME="partitions.csv"
CONFIG_PARTITION_TABLE_FILENAME="partitions.csv"
```

## examples/peripherals/pwm/pwm_info_clac/main/Kconfig.projbuild
```kconfig
menu "Example Configuration"

    config PWM_CAPTURE_IO
        int "Pwm Capture Io"
        default 2
        help
           Example used gpio for capture pwm.

endmenu
```

## examples/peripherals/sdmmc/sdcard_performance/sdkconfig.defaults
```kconfig
CONFIG_IDF_TARGET="esp32p4"
CONFIG_SPIRAM=y
CONFIG_SPIRAM_SPEED_250M=y
CONFIG_FATFS_VFS_FSTAT_BLKSIZE=4096
```

## examples/pie/math/shift_operation/sdkconfig.defaults
```kconfig
CONFIG_IDF_TARGET="esp32s3"
CONFIG_IDF_TARGET_ESP32S3=y

CONFIG_ESP32S3_DEFAULT_CPU_FREQ_240=y
CONFIG_ESP32S3_INSTRUCTION_CACHE_32KB=y
CONFIG_ESP32S3_INSTRUCTION_CACHE_LINE_32B=y
CONFIG_ESP32S3_DATA_CACHE_64KB=y
CONFIG_ESP32S3_DATA_CACHE_LINE_64B=y
```

## examples/pie/memory/memcpy/sdkconfig.defaults
```kconfig
CONFIG_IDF_TARGET="esp32s3"
CONFIG_IDF_TARGET_ESP32S3=y

CONFIG_ESP32S3_DEFAULT_CPU_FREQ_240=y

CONFIG_ESP32S3_SPIRAM_SUPPORT=y
CONFIG_SPIRAM_MODE_OCT=y
CONFIG_SPIRAM_SPEED_80M=y
```

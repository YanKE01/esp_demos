## examples/ui/lvgl/lvgl_spiffs/sdkconfig.defaults
```kconfig
CONFIG_LV_USE_FS_STDIO=y
CONFIG_LV_FS_STDIO_LETTER=83
CONFIG_LV_USE_PNG=y
CONFIG_LV_USE_GIF=y
CONFIG_LV_USE_SJPG=y
CONFIG_LV_USE_QRCODE=y

CONFIG_IDF_TARGET="esp32s3"
CONFIG_IDF_TARGET_ESP32S3=y

CONFIG_ESP32S3_DEFAULT_CPU_FREQ_240=y
CONFIG_LV_COLOR_16_SWAP=y

CONFIG_PARTITION_TABLE_CUSTOM=y
CONFIG_PARTITION_TABLE_CUSTOM_FILENAME="partitions.csv"
CONFIG_PARTITION_TABLE_FILENAME="partitions.csv"

CONFIG_ESPTOOLPY_FLASHSIZE_8MB=y
CONFIG_LV_MEM_CUSTOM=y
CONFIG_LV_MEM_CUSTOM_INCLUDE="stdlib.h"
CONFIG_LV_MEM_BUF_MAX_NUM=16

CONFIG_LV_USE_PERF_MONITOR=y
CONFIG_LV_PERF_MONITOR_ALIGN_BOTTOM_RIGHT=y
```

## examples/ui/wououi/sdkconfig.defaults
```kconfig
CONFIG_IDF_TARGET="esp32s3"
CONFIG_IDF_TARGET_ESP32S3=y

CONFIG_ESP32S3_DEFAULT_CPU_FREQ_240=y
CONFIG_FREERTOS_HZ=1000
```

## examples/usb/device/cdc_acm/main/Kconfig.projbuild
```kconfig
menu "USB Device CDC Configuration"

    menu "TinyUSB Configuration"

        config TUSB_VID
            hex "USB Device VID"
            default 0x303A
        config TUSB_PID
            hex "USB Device PID"
            default 0x2986 if HID_TOUCH_ENABLE || UAC_AUDIO_ENABLE
            default 0x2987 if !HID_TOUCH_ENABLE && !UAC_AUDIO_ENABLE
        config TUSB_MANUFACTURER
            string "USB Device Manufacture"
            default "Espressif"

        choice TINYUSB_RHPORT
            prompt "TinyUSB Root Port"
            default TINYUSB_RHPORT_HS if IDF_TARGET_ESP32P4
            default TINYUSB_RHPORT_FS
            help
                Allows set the USB PHY Controller for TinyUSB: HS (USB OTG2.0 PHY for HighSpeed)

            config TINYUSB_RHPORT_HS
                depends on IDF_TARGET_ESP32P4
                bool "High Speed"

            config TINYUSB_RHPORT_FS
                bool "Full Speed"
        endchoice


    endmenu

    menu "Communication Device Class (CDC)"
        config TINYUSB_CDC_RX_BUFSIZE
            int "CDC FIFO size of RX channel"
            default 512
            range 64 10000
            help
                CDC FIFO size of RX channel.
    endmenu

endmenu
```

## examples/usb/host/dp100/sdkconfig.defaults
```kconfig
CONFIG_IDF_TARGET="esp32s3"
CONFIG_IDF_TARGET_ESP32S3=y

CONFIG_ESP_INT_WDT=n
CONFIG_ESP_TASK_WDT=n

CONFIG_ESPTOOLPY_FLASHSIZE_16MB=y
CONFIG_ESPTOOLPY_FLASHSIZE="16MB"
```
